/*
 * Copyright (c) 2020 Nordic Semiconductor ASA
 *
 * SPDX-License-Identifier: Apache-2.0
 */

/* This overlay is used solely for manual build-testing of the
 * ieee802154 cc2525 driver.  There is no such device on this
 * bus on this board.
 */
&spi2 {
	cs-gpios = <&gpio0 0 0>;
	status = "okay";
	cc2520@0 {
		reg = <0>;
		spi-max-frequency = <1000000>;
		label = "cc2520";
		status = "okay";
		compatible = "ti,cc2520";
		vreg-en-gpios = <&gpio0 1 0>;
		reset-gpios = <&gpio0 2 0>;
		fifo-gpios = <&gpio0 3 0>;
		cca-gpios = <&gpio0 4 0>;
		sfd-gpios = <&gpio0 5 0>;
		fifop-gpios = <&gpio0 6 0>;
      };
};
