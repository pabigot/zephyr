## samples/net/wpan_serial/boards/particle_xenon.conf
```kconfig
#
# Copyright (c) 2020 Nordic Semiconductor ASA
#
# SPDX-License-Identifier: Apache-2.0
#
CONFIG_SPI=y
CONFIG_IEEE802154_NRF5=n
CONFIG_IEEE802154_CC2520=y
```

## samples/subsys/fs/littlefs/boards/nrf52840_pca10056.conf
```kconfig
#
# Copyright (c) 2019 Peter Bigot Consulting, LLC
#
# SPDX-License-Identifier: Apache-2.0
#

# Need this when storage is on flash
CONFIG_MPU_ALLOW_FLASH_WRITE=y

# Disable the flash interface for SPI2 which is incomplete once the
# flash node is deleted from devicetree.
CONFIG_SPI_2=n

CONFIG_QSPI_NOR=y
CONFIG_QSPI_NOR_FLASH_LAYOUT_PAGE_SIZE=4096
```

## tests/drivers/gpio/gpio_api_1pin/testcase.yaml
```yaml
tests:
  peripheral.gpio:
    tags: drivers gpio
    depends_on: gpio
    filter: DT_ALIAS_LED0_GPIOS_CONTROLLER
```

## tests/drivers/i2c/i2c_emul/boards/native_posix.conf
```kconfig
CONFIG_I2C_EMUL=y
CONFIG_EMUL=y
CONFIG_EMUL_EEPROM_AT2X=y
CONFIG_I2C_LOG_LEVEL_DBG=y
CONFIG_EEPROM_AT24=y
CONFIG_EEPROM=y
```

## tests/drivers/i2c/i2c_emul/testcase.yaml
```yaml
tests:
  drivers.i2c:
    depends_on: i2c
    tags: drivers i2c
    platform_whitelist: native_posix
```

## tests/subsys/fs/littlefs/boards/nrf52840_pca10056.conf
```kconfig
#
# Copyright (c) 2019 Peter Bigot Consulting, LLC
#
# SPDX-License-Identifier: Apache-2.0
#

# Disable the flash interface for SPI2 which is incomplete once the
# flash node is deleted from devicetree.
CONFIG_SPI_2=n

CONFIG_QSPI_NOR=y
CONFIG_QSPI_NOR_FLASH_LAYOUT_PAGE_SIZE=4096
```
