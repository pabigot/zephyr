/* Copyright (c) 2020 Nordic Semiconductor ASA
 * SPDX-License-Identifier: Apache-2.0
 */

/ {
  /delete-node/ eeprom;
  aliases {
    /delete-property/ eeprom-0;
    eeprom-0 = &i2cep;
  };
};


&i2c0 {
  i2cep: eeprom@57 {
    compatible = "atmel,at24";
    reg = <0x57>;
    label = "eeprom";
    size = <256>;
    pagesize = <8>;
    address-width = <8>;
    timeout = <5>;
  };
};
