/* Copyright (c) 2020 Nordic Semiconductor ASA
 * SPDX-License-Identifier: Apache-2.0
 */

/ {
	aliases {
		accel-0 = &bmi;
	};
};

&spi0 {
	bmi: bmi@0 {
		compatible = "bosch,bmi160";
		spi-max-frequency = <50000000>;
		reg = <0>;
		label = "accel";
	};
};
