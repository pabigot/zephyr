## drivers/flash/Kconfig.nordic_qspi_nor
```kconfig
# Copyright (c) 2019, Nordic Semiconductor ASA
# SPDX-License-Identifier: Apache-2.0

menuconfig QSPI_NOR
	bool "QSPI NOR Flash"
	select FLASH_HAS_DRIVER_ENABLED
	depends on HAS_HW_NRF_QSPI

if QSPI_NOR
config QSPI_NRF_QSPI
	bool "nRF QSPI nrfx driver"
	default y
	select NRFX_QSPI
	help
	  Enable support for nrfx QSPI driver with EasyDMA.

config	QE_BIT
	int "Quad Enable bit number in Status Regiter"
	default 6

config QSPI_NOR_INIT_PRIORITY
	int
	default 80
	help
	  Device driver initialization priority.
	  Device is connected to SPI bus, it has to
	  be initialized after SPI driver.

config QSPI_NOR_FLASH_LAYOUT_PAGE_SIZE
	int "Page size to use for FLASH_LAYOUT feature"
	default 65536
	help
	  When CONFIG_FLASH_PAGE_LAYOUT is used this driver will support
	  that API.  By default the page size corresponds to the block
	  size (65536).  Other option include the sector size (4096).

endif # QSPI_NOR
```

## drivers/gpio/Kconfig.sx1509b
```kconfig
# SX1509B GPIO configuration options

# Copyright (c) 2018 Aapo Vienamo
# SPDX-License-Identifier: Apache-2.0

# Workaround for not being able to have commas in macro arguments
DT_COMPAT_SEMTECH_SX1509B := semtech,sx1509b

menuconfig GPIO_SX1509B
	bool "SX1509B I2C GPIO chip"
	default $(dt_compat_enabled,$(DT_COMPAT_SEMTECH_SX1509B))
	depends on I2C
	help
	  Enable driver for SX1509B I2C GPIO chip.

config GPIO_SX1509B_INIT_PRIORITY
	int "Init priority"
	depends on GPIO_SX1509B
	default 70
	help
	  Device driver initialization priority.

config GPIO_SX1509B_INTERRUPT
	bool "Interrupt enable"
	depends on GPIO_SX1509B
	default n
	help
	  Enable interrupts on gpio pins.

config GPIO_SX1509B_DEBOUNCE_TIME
	int "Debounce time interval"
	depends on GPIO_SX1509B
	range 0 7
	default 0
	help
	  Debounce time interval when debounce enabled.
```

## drivers/i2c/Kconfig.i2c_sim
```kconfig
# Copyright 2020 Google LLC
# SPDX-License-Identifier: Apache-2.0

config I2C_SIM
	bool "I2C simulator"
	help
	  Enable the I2C simulator driver. This is a fake driver in that it
	  does not talk to real hardware. Instead it talks to emulation
	  drivers that pretend to be devices on the emulated I2C bus. It is
	  used for testing drivers for I2C devices.
```

## drivers/sensor/sht21/Kconfig
```kconfig
#
# Copyright (c) 2018 Peter Bigot Consulting, LLC
#
# SPDX-License-Identifier: Apache-2.0
#

menuconfig SHT21
	bool "SHT21 Temperature and Humidity Sensor"
	depends on I2C
	help
	  Enable driver for SHT21 temperature and humidity sensors.

if SHT3XD

endif # SHT3XD
```

## drivers/sensple/Kconfig
```kconfig
# Kconfig - sensple configuration options

#
# Copyright (c) 2019 Peter Bigot Consulting, LLC
#
# SPDX-License-Identifier: Apache-2.0
#

menuconfig SENSPLE
	bool "Simplified Sensor Drivers"
	help
	  Include sensple drivers in system config

if SENSPLE

module = SENSPLE
module-str = sensple
source "subsys/logging/Kconfig.template.log_config"

config SENSPLE_INIT_PRIORITY
	int "Sensple init priority"
	default 90
	help
	  Sensple initialization priority.

comment "Device Drivers"

source "drivers/sensple/sht21/Kconfig"

source "drivers/sensple/sdp8xx/Kconfig"

endif # SENSOR
```

## drivers/sensple/as3935/Kconfig
```kconfig
#
# Copyright (c) 2019 Peter Bigot Consulting, LLC
#
# SPDX-License-Identifier: Apache-2.0
#

menuconfig SENSPLE_AS3935
	bool "AS3935 Lightning Sensor"
	depends on I2C
	help
	  Enable sensple driver for AMS AS3935 Franklin Lightning Sensor
```

## drivers/sensple/sdp8xx/Kconfig
```kconfig
#
# Copyright (c) 2019 Peter Bigot Consulting, LLC
#
# SPDX-License-Identifier: Apache-2.0
#

menuconfig SENSPLE_SDP8XX
	bool "SDP8XX Differential Pressure and Temperature Sensors"
	depends on I2C
	help
	  Enable sensple driver for SDP800/SDP810 differential pressure
	  sensors.
```

## drivers/sensple/sht21/Kconfig
```kconfig
#
# Copyright (c) 2018 Peter Bigot Consulting, LLC
#
# SPDX-License-Identifier: Apache-2.0
#

menuconfig SENSPLE_SHT21
	bool "SHT21 Temperature and Humidity Simplified Sensor"
	depends on I2C
	help
	  Enable sensple driver for SHT21-compatible temperature and
	  humidity sensors, including HTU21D and Si7021.
```

## dts/bindings/i2c/zephyr,sim-i2c.yaml
```yaml
# Copyright 2020 Google LLC
# SPDX-License-Identifier: Apache-2.0

description: I2C emulator

compatible: "zephyr,sim-i2c"

include: i2c-controller.yaml

properties:
    reg:
      required: true
      description: Nominal address space for the controller
```

## dts/bindings/misc/regulator-gpio.yaml
```yaml
#
# Copyright (c) 2019, Peter Bigot Consulting, LLC
#
# SPDX-License-Identifier: Apache-2.0
#

title: GPIO-controlled regulators

description: A definition for a GPIO-controlled switch.

compatible: "regulator-gpio"

include: regulator.yaml

# NOTE: GPIO polarity is defined by the enable-gpios flags, as
# Zephyr does not have the legacy devicetree problem that requires
# Linux to use a separate enable-active-high property.
#
# Also Zephyr uses label instead of regulator-name.
properties:
  label:
    required: true

  enable-gpios:
    type: phandle-array
    required: true
    description: The GPIO that controls the switch.
    
  startup-delay-us:
    type: int
    required: false
    default: 0
    description: Startup time, in microseconds.

  gpio-waits:
    type: boolean
    description: Indicates GPIO setting operation waits.
```

## dts/bindings/misc/regulator.yaml
```yaml
#
# Copyright (c) 2019, Peter Bigot Consulting, LLC
#
# SPDX-License-Identifier: Apache-2.0
#

title: Voltage/Current Regulators

include: base.yaml

# Linux defines several dozen properties.  We're providing only the ones
# currently useful to Zephyr.
properties:
  regulator-always-on:
    type: boolean
    description: regulator should always be on

  regulator-boot-on:
    type: boolean
    description: regulator should be turned on at startup
```

## dts/bindings/net/wireless/nordic,nrf-radio.yaml
```yaml
# Copyright (c) 2020 Nordic Semiconductor ASA
# SPDX-License-Identifier: Apache-2.0

description: |
    Nordic nRF family RADIO

    dfegpio[n]-gpios properties provide GPIO pins to the radio peripheral. These
    GPIO pins are used to drive antennas switching by Radio Direction Finding
    Extension. E.g. to use 12 antennas 4 GPIO pins must be provided;
    4 GPIO pins support switching up to 16 antennas.

    The dfegpio[n] properties are used to initialize the PSEL.DFEGPIO[n]
    registers. None of the dfegpio[n]-gpios properties are marked required,
    since which Radio PSEL.DFEGPIO[n] registers will be used to drive antenna
    switches depends on the use case.

    Nevertheless, at least two antennas must be available. That means at
    least one dfegpio[n]-gpios property must be provided, to give the radio
    the possibility to switch between two antennas.

compatible: "nordic,nrf-radio"

include: [base.yaml]

properties:
    reg:
      required: true

    interrupts:
      required: true

    has-802154:
      type: boolean
      description: |
        Indicates whether the radio has 802.15.4 protocol support.

    has-dfe:
      type: boolean
      description: |
        Indicates whether the radio supports the BLE Direction Finding
        Extension.

    dfe-ant-num:
      type: int
      required: false
      description: |
        Number of available antennas.

        Value zero means no antenna available. If provided value different than
        zero, it must be greater or equal to two.

        This property must be present if and only if has-dfe is true.

    dfegpio0-gpios:
      type: phandle-array
      required: false
      description: |
        Pin select for DFE pin 0

        Flags cell in the property is not used for GPIO pin initialization
        and should be set to zero.

        This property must be absent if has-dfe is false.

    dfegpio1-gpios:
      type: phandle-array
      required: false
      description: |
        Pin select for DFE pin 1

        Flags cell in the property is not used for GPIO pin initialization
        and should be set to zero.

        This property must be absent if has-dfe is false.

    dfegpio2-gpios:
      type: phandle-array
      required: false
      description: |
        Pin select for DFE pin 2

        Flags cell in the property is not used for GPIO pin initialization
        and should be set to zero.

        This property must be absent if has-dfe is false.

    dfegpio3-gpios:
      type: phandle-array
      required: false
      description: |
        Pin select for DFE pin 3

        Flags cell in the property is not used for GPIO pin initialization
        and should be set to zero.

        This property must be absent if has-dfe is false.

    dfegpio4-gpios:
      type: phandle-array
      required: false
      description: |
        Pin select for DFE pin 4

        Flags cell in the property is not used for GPIO pin initialization
        and should be set to zero.

        This property must be absent if has-dfe is false.

    dfegpio5-gpios:
      type: phandle-array
      required: false
      description: |
        Pin select for DFE pin 5

        Flags cell in the property is not used for GPIO pin initialization
        and should be set to zero.

        This property must be absent if has-dfe is false.

    dfegpio6-gpios:
      type: phandle-array
      required: false
      description: |
        Pin select for DFE pin 6

        Flags cell in the property is not used for GPIO pin initialization
        and should be set to zero.

        This property must be absent if has-dfe is false.

    dfegpio7-gpios:
      type: phandle-array
      required: false
      description: |
        Pin select for DFE pin 7

        Flags cell in the property is not used for GPIO pin initialization
        and should be set to zero.

        This property must be absent if has-dfe is false.
```

## dts/bindings/power/maxim,max1704x.yaml
```yaml
#
# Copyright (c) 2018, Makaio GmbH
#
# SPDX-License-Identifier: Apache-2.0
#
---
title: Maxim Integrated MAX1704X Fuel Gauge
version: 0.1

description: >
  This binding gives a base representation of  MAX1704x Fuel Gauge

inherits:
  !include [i2c-device.yaml]

properties:
  compatible:
    constraint: "maxim,max1704x"

  alrt-gpios:
    type: compound
    category: optional
    description: ALRTn pin
    generation: define, use-prop-name
  qstrt-gpios:
    type: compound
    category: optional
    description: QSTRT pin
    generation: define, use-prop-name

...
```

## dts/bindings/power/state.yaml
```yaml
# Copyright (c) 2020, Intel Corporation
# SPDX-License-Identifier: Apache-2.0

description: Properties for power management state

compatible: "pm-state"

properties:
    pm-state:
        type: string
        required: true
        description: indicates a power state
        enum:
            - "ACTIVE"
            - "RUNTIME_IDLE"
            - "SUSPEND_TO_IDLE"
            - "STANDBY"
            - "SUSPEND_TO_RAM"
            - "SUSPEND_TO_DISK"
            - "SOFT_OFF"

    min-residency-us:
        type: int
        required: false
        description: |
            Minimum residency duration in microseconds. It is the minimum time for a
            given idle state to be worthwhile energywise.
```

## dts/bindings/power/ti,bq24195.yaml
```yaml
#
# Copyright (c) 2018 Peter Bigot Consulting, LLC
#
# SPDX-License-Identifier: Apache-2.0
#
---
title: Texas Instruments bq124195 Single Cell USB/Adapter Charger
version: 0.1

description: >
  switch-mode battery charge management and system power path
  management devices for single cell Li-Ion and Li-polymer
  batteries.

inherits:
  !include [i2c-device.yaml]

properties:
  compatible:
    constraint: "ti,bq24195"

  ce-gpios:
    type: compound
    category: optional
    description: CEn pin
    generation: define, use-prop-name
  int-gpios:
    type: compound
    category: optional
    description: INT pin
    generation: define, use-prop-name

...
```

## dts/bindings/rtc/maxim,ds3231.yaml
```yaml
#
# Copyright (c) 2019 Peter Bigot Consulting, LLC
#
# SPDX-License-Identifier: Apache-2.0
#

description: |
    Bindings for the Maxim DS3231 I2C RTC/TCXO

include: i2c-device.yaml

compatible: "maxim,ds3231"

properties:
    32k-gpios:
      type: phandle-array
      required: false
      description: |
        32 KiHz open drain output

        The DS3231 defaults to providing a 32 KiHz square wave on this
        signal.  The driver does not make use of this, but applications
        may want access.

    isw-gpios:
      type: phandle-array
      required: false
      description: |
        interrupt/square wave open drain output

        The DS3231 uses this signal to notify when an alarm has
        triggered, and also to produce a square wave aligned to the
        countdown chain.  Both capabilities are used within the driver.
        This signal must be present to support time set and read
        operations that preserve sub-second accuracy.
```

## dts/bindings/sensor/ams,as3935-i2c.yaml
```yaml
# Copyright (c) 2019, Peter Bigot Consulting, LLC
# SPDX-License-Identifier: Apache-2.0

title:  Microsystems Lightning Sensor AS3935

description: >
    This binding gives a base representation of the Austria Microsystems
    Lightning Sensor IC.

compatible: "ams,as3935"

include: i2c-device.yaml

properties:
    irq-gpios:
      type: compound
      category: optional

      
```

## dts/bindings/sensor/sensirion,sdp8xx.yaml
```yaml
# Copyright (c) 2019, Peter Bigot Consulting, LLC
# SPDX-License-Identifier: Apache-2.0

description: Sensirion SDP8xx differential pressure sensor

compatible: "sensirion,sdp8xx"

include: i2c-device.yaml
```

## dts/bindings/sensor/sensirion,sht21.yaml
```yaml
# Copyright (c) 2018, Peter Bigot Consulting, LLC
# SPDX-License-Identifier: Apache-2.0

description: |
  The Sensirion Humidity Sensor SHT21 supports measuring temperature and
  humidity.  Compatibles include meas,htu21 and silabs,si7021.

# meas,htu21
# silabs,si7021
compatible: "sensirion,sht21"

include: i2c-device.yaml
```

## dts/bindings/sensor/st,lis2dh-common.yaml
```yaml
# Copyright (c) 2018 STMicroelectronics
# SPDX-License-Identifier: Apache-2.0

# Material common to st,lis2dh ; st,lis2dh12 ; st,lis3dh

properties:
    irq-gpios:
      type: phandle-array
      required: false
```
