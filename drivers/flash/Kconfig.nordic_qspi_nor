## lib/os/Kconfig.vcbprintf
```kconfig
# Copyright (c) 2020 Nordic Semiconductor ASA
# SPDX-License-Identifier: Apache-2.0

config VCBPRINTF_64BIT_SUPPORT
	bool "Enable 64-bit formatting"
	default y
	help
	  Build the sys_vcbprintf utility function with support for the 64-bit
	  formatting.  This will increase stack size requirements slightly on
	  systems with 32-bit long integers.  It has no significant impact on
	  code size.

	  If not selected conversions with the ll or j length modifiers will
	  not be generated.  It has no effect on the z or t length modifiers,
	  though those values, as well as pointer values, may be truncated if
	  they do not fit in 32 bits.

config VCBPRINTF_FP_SUPPORT
	bool "Enable floating point formatting in sys_vcbprintf"
	default y # if SHELL
	help

	  Build the sys_vcbprintf utility function with support for floating
	  point format specifiers.  Selecting this increases stack size
	  requirements slightly, but increases code size significantly.

config VCBPRINTF_FULL_WIDTH
	bool "Use full representation for the width and precision lengths"
	help
	  The formatting process can require storing up to six values related
	  to width and precision of formatted values.  By default it is
	  assumed that no value will exceed 255, which reduces stack space in
	  the formatter.  Select this option if longer formatted lengths are
	  required.

config VCBPRINTF_N_SPECIFIER
	bool "Support %n specifications"
	default y
	help
	  If selected %n can be used to determine the number of characters
	  emitted.  If disabled there is a small reduction in code size.

config VCBPRINTF_NULL_AS_NIL
	bool "Emit null pointers a nil instead of numeric"
	default n
	help
	  If selected a null pointer formatted with %p will be converted to
	  the string "nil" rather to a zero hexadecimal string.
```

## samples/drivers/spi_flash/boards/nrf52840_pca10056.conf
```kconfig
#
# Copyright (c) 2019 Nordic Semiconductor ASA
#
# SPDX-License-Identifier: Apache-2.0
#

# Disable the flash interface for SPI2 which is incomplete once the
# flash node is deleted from devicetree, then switch to QSPI NOR
# driver.
CONFIG_SPI_2=n
CONFIG_SPI_NOR=n
CONFIG_QSPI_NOR=y
```

## samples/drivers/uart/api/boards/particle_xenon.conf
```kconfig
CONFIG_RING_BUFFER=y

CONFIG_UART_CONSOLE_ON_DEV_NAME="UART_1"
CONFIG_UART_LINE_CTRL=y

#CONFIG_UART_ASYNC_API=y
# If using UARTE you really need HW_ASYNC because otherwise partial
# buffers won't result in proper notification.  UARTE is mostly fast
# enough to not fret about flow control; flow control alone doesn't
# mitigate lack of async rx counting.
#
# However, HW_ASYNC only works with ASYNC_API, and nobody helps you
# figure out what timer you can use for this.
CONFIG_UART_0_NRF_HW_ASYNC=y
CONFIG_UART_0_NRF_HW_ASYNC_TIMER=4

#CONFIG_UART_INTERRUPT_DRIVEN=y

# If using UART you'll get overruns at full speed without flow control.
# CONFIG_UART_0_NRF_FLOW_CONTROL=y
```
